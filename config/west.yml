## config/west.yml
```yaml
manifest:
  remotes:
    - name: zmkfirmware
      url-base: https://github.com/zmkfirmware
    - name: bildermankawasaki
      url-base: https://github.com/bildermankawasaki
    - name: ypaypa
      url-base: https://github.com/ypaypa
  projects:
    - name: zmk
      remote: zmkfirmware
      revision: v0.3
      import: app/west.yml
    - name: zmk-keyboard-totem
      remote: bildermankawasaki
      revision: main
    - name: zmk-totem-telemetry
      remote: ypaypa
      revision: main
```
